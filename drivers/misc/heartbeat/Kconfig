## drivers/misc/heartbeat/Kconfig
```kconfig
# SPDX-License-Identifier: GPL-2.0-only
#
# QTI Heartbeat device driver configuration
#

config QTI_HEARTBEAT
	bool "QTI Heartbeat"
	depends on QTI_CAN
	help
	  Say Y here if you have a heartbeat gpio connected to your system.
	  When in doubt, say N.
```

## drivers/misc/usb7002/Kconfig
```kconfig
# SPDX-License-Identifier: GPL-2.0-only
#
# usb7002 device driver configuration
#

config USB7002_HUB
	bool "usb7002 hub driver"
	default n
	help
	  Say Y here if you have a usb7002 connected to your system.
	  When in doubt, say N.
```
