## drivers/misc/tri_state_key/Kconfig
```kconfig
config OPLUS_TRI_STATE_KEY
	tristate "oplus tri state key support"
	default n
	help
	  Say Y here if you want to enable the feature.
```

## drivers/power/oplus/Kconfig
```kconfig
#ifdef OPLUS_FEATURE_CHG_BASIC
config OPLUS_SM7250R_CHARGER
	tristate "OPLUS SM7250R charger driver"
	depends on MFD_SPMI_PMIC
	help
	  Enables support for the oplus charging framework

config OPLUS_SHORT_C_BATT_CHECK
	tristate "OPLUS_SHORT_C_BATT CHECK SUPPORT"
	default n
	depends on MFD_SPMI_PMIC
	help
	  Say Y to include support

config OPLUS_CALL_MODE_SUPPORT
	bool "OPLUS call mode support"
	help
	  Say Y to include support

config OPLUS_SMART_CHARGER_SUPPORT
	bool "OPLUS smart charger support"
	help
	  Say Y to include support

config OPLUS_SHORT_HW_CHECK
	tristate "OPLUS_SHORT_HW CHECK SUPPORT"
	default n
	depends on MFD_SPMI_PMIC
	help
	  Say Y to include support

config OPLUS_CHIP_SOC_NODE
	bool "OPLUS chip soc node"
	help
	  Say Y to include support

config OPLUS_SHORT_IC_CHECK
	tristate "OPLUS_SHORT_IC CHECK SUPPORT"
	default n
	depends on MFD_SPMI_PMIC
	help
	  Say Y to include support

config OPLUS_SHORT_USERSPACE
	bool "OPLUS batt userspace"
	help
	  Say Y to include support

config OPLUS_CHECK_CHARGERID_VOLT
	tristate "OPLUS CHECK CHARGERID VOLT"
	default n
	depends on MFD_SPMI_PMIC
	help
	  Say Y to include support

config OPLUS_SHIP_MODE_SUPPORT
	tristate "OPLUS_SHIP_MODE_SUPPORT"
	default n
	depends on MFD_SPMI_PMIC
	help
	  Say Y to include support

config OPLUS_SMOOTH_SOC
	bool "OPLUS config smooth soc "
	help
	  Say Y here to include smooth soc
#endif
```

## drivers/soc/oplus/Kconfig
```kconfig
source "drivers/soc/oplus/device_info/Kconfig"
source "drivers/soc/oplus/misc/Kconfig"
source "drivers/soc/oplus/sensor/Kconfig"
source "drivers/soc/oplus/system/Kconfig"
source "drivers/soc/oplus/thermal/Kconfig"
```
